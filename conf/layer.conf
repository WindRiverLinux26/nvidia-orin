## conf/machine/nvidia-orin-agx.conf
```bitbake
#@TYPE: Machine
#@NAME: Nvidia Jetson AGX Orin 64GB
#@DESCRIPTION: Nvidia Jetson Orin dev kit (P3701-0005 module in P3737-0000 carrier)

TEGRA_BOARDSKU ?= "0005"
TEGRA_BUPGEN_SPECS ?= "fab=300;boardsku=0005;boardrev=;chipsku=00:00:00:D0;bup_type=bl \
                       fab=300;boardsku=0005;boardrev=;bup_type=kernel"
TEGRA_FLASHVAR_BPFDTB_FILE ?= "tegra234-bpmp-3701-0005-3737-0000.dtb"
TEGRA_FLASHVAR_PMIC_CONFIG ?= "tegra234-mb1-bct-pmic-p3701-0005.dts"
TEGRA_FLASHVAR_WB0SDRAM_BCT ?= "tegra234-p3701-0005-wb0sdram-l4t.dts"

EMMC_BCT ?= "tegra234-p3701-0005-sdram-l4t.dts"
ROOTFSPART_SIZE_DEFAULT ?= "59055800320"

require ${@bb.utils.contains('BUILD_NVIDIA_PROPRIETARY_PACKAGE', '1', \
			     'conf/machine/include/agx-orin.inc', '', d)}

require nvidia-orin-common.inc

KERNEL_DEVICETREE ?= "tegra234-p3737-0000+p3701-0005-nv.dtb"

BSP_NVIDIA_DERIVED:append = " nvidia-orin-agx"

TEGRA_PLUGIN_MANAGER_OVERLAYS:append = " ${@bb.utils.contains('BUILD_NVIDIA_PROPRIETARY_PACKAGE', '1', \
	'tegra234-p3737-camera-imx477-overlay.dtbo', '', d)}"

BOOTABLE_OVERLAY ?= "tegra234-p3737-0000+p3701-0005-nv-boot-overlay.dtbo"
```

## conf/machine/nvidia-orin-common.inc
```bitbake
# Common settings for BSP machine.conf

DEFAULTTUNE ?= "armv8a-crc"
require ${@bb.utils.contains('BUILD_NVIDIA_PROPRIETARY_PACKAGE', '1', \
			     '', 'conf/machine/include/arm/arch-armv8-2a.inc', d)}

MACHINE_FEATURES ??= "alsa usbhost pci rtc ext2 wifi bluetooth"

KERNEL_IMAGETYPE ?= "Image"

SERIAL_CONSOLES ??= "115200;ttyTCU0"

PREFERRED_PROVIDER_virtual/kernel ?= "linux-yocto"
PREFERRED_VERSION_linux-yocto ?= "6.18%"
PREFERRED_VERSION_linux-yocto-rt ?= "6.18%"

MACHINE_EXTRA_RRECOMMENDS:append = " kernel-modules linux-firmware-rtl8822 kernel-module-rtw88-8822ce kernel-module-rtk-btusb kernel-module-snd-soc-rl6231 kernel-module-snd-soc-rt5640"
IMAGE_FSTYPES += "tar.bz2 ext4"
IMAGE_INSTALL:append = " kernel-image-image"

MACHINEOVERRIDES:append = ":nvidia-orin"

# If enable reduntant flash layout, L4TConfiguration-RootfsRedundancyLevelABEnable.dtbo will be installed
USE_REDUNDANT_FLASH_LAYOUT_DEFAULT ?= "1"

ASSUME_PROVIDED += "${@bb.utils.contains('BUILD_NVIDIA_PROPRIETARY_PACKAGE', '1', \
	'', 'virtual/bootloader', d)}"
OSTREE_SD_UBOOT_WIC1 = ""
```

## conf/machine/nvidia-orin-nano.conf
```bitbake
#@TYPE: Machine
#@NAME: Nvidia Jetson Orin Nano 8GB (P3767-0005)
#@DESCRIPTION: Nvidia Jetson Orin dev kit (P3767-0005 module in P3768-0000 carrier)

TNSPEC_BOOTDEV ?= "nvme0n1p1"
PARTITION_LAYOUT_TEMPLATE_DEFAULT ?= "flash_t234_qspi.xml"
PARTITION_LAYOUT_TEMPLATE_DEFAULT_SUPPORTS_REDUNDANT ?= "1"
PARTITION_LAYOUT_EXTERNAL_DEFAULT ?= "flash_l4t_t234_nvme.xml"

TEGRAFLASH_SDCARD_SIZE ?= "63G"
ROOTFSPART_SIZE_DEFAULT ?= "59055800320"
ROOTFSPART_SIZE ?= "${ROOTFSPART_SIZE_DEFAULT}"

KERNEL_DEVICETREE ?= "tegra234-p3768-0000+p3767-0005-nv-super.dtb"

require ${@bb.utils.contains('BUILD_NVIDIA_PROPRIETARY_PACKAGE', '1', \
			     'conf/machine/include/orin-nano.inc', '', d)}

require nvidia-orin-common.inc

MACHINEOVERRIDES:append = ":jetson-orin-nano-devkit"

BSP_NVIDIA_DERIVED:append=" nvidia-orin-nano"

TEGRA_PLUGIN_MANAGER_OVERLAYS:append = " ${@bb.utils.contains('BUILD_NVIDIA_PROPRIETARY_PACKAGE', '1', \
	'tegra234-p3767-camera-p3768-imx219-dual.dtbo', '', d)}"

BOOTABLE_OVERLAY ?= "tegra234-p3768-0000+p3767-0005-nv-super-boot-overlay.dtbo"
```
